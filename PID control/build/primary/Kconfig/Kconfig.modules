## PID control/build/primary/Kconfig/Kconfig.modules
```kconfig
menu "cmsis (/Users/anuj/pico/deps/modules/hal/cmsis)"
osource "$(ZEPHYR_CMSIS_KCONFIG)"
config ZEPHYR_CMSIS_MODULE
	bool
	default y
endmenu
menu "cmsis-dsp (/Users/anuj/pico/deps/modules/lib/cmsis-dsp)"
osource "$(ZEPHYR_CMSIS_DSP_KCONFIG)"
config ZEPHYR_CMSIS_DSP_MODULE
	bool
	default y
endmenu
menu "cmsis_6 (/Users/anuj/pico/deps/modules/hal/cmsis_6)"
osource "$(ZEPHYR_CMSIS_6_KCONFIG)"
config ZEPHYR_CMSIS_6_MODULE
	bool
	default y
endmenu
menu "hal_rpi_pico (/Users/anuj/pico/deps/modules/hal/rpi_pico)"
osource "$(ZEPHYR_HAL_RPI_PICO_KCONFIG)"
config ZEPHYR_HAL_RPI_PICO_MODULE
	bool
	default y
endmenu
menu "percepio (/Users/anuj/pico/deps/modules/debug/percepio)"
osource "/Users/anuj/pico/deps/modules/debug/percepio/zephyr/Kconfig"
config ZEPHYR_PERCEPIO_MODULE
	bool
	default y
endmenu
menu "picolibc (/Users/anuj/pico/deps/modules/lib/picolibc)"
osource "/Users/anuj/pico/deps/modules/lib/picolibc/zephyr/Kconfig"
config ZEPHYR_PICOLIBC_MODULE
	bool
	default y
endmenu
menu "segger (/Users/anuj/pico/deps/modules/debug/segger)"
osource "$(ZEPHYR_SEGGER_KCONFIG)"
config ZEPHYR_SEGGER_MODULE
	bool
	default y
endmenu
```

## PID control/build/primary/Kconfig/Kconfig.sysbuild.modules
```kconfig
config ZEPHYR_CMSIS_MODULE
   bool
   default y
config ZEPHYR_CMSIS_DSP_MODULE
   bool
   default y
config ZEPHYR_CMSIS_6_MODULE
   bool
   default y
config ZEPHYR_HAL_RPI_PICO_MODULE
   bool
   default y
config ZEPHYR_PERCEPIO_MODULE
   bool
   default y
config ZEPHYR_PICOLIBC_MODULE
   bool
   default y
config ZEPHYR_SEGGER_MODULE
   bool
   default y
```

## PID control/build/primary/Kconfig/boards/Kconfig.rpi_pico2
```kconfig
# Load board Kconfig descriptions.
osource "/Users/anuj/pico/deps/zephyr/boards/raspberrypi/rpi_pico2/Kconfig.rpi_pico2"
```

## PID control/build/primary/Kconfig/soc/Kconfig
```kconfig
# Load Zephyr SoC Kconfig descriptions.
osource "/Users/anuj/pico/deps/zephyr/soc/xlnx/zynqmp/Kconfig"
osource "/Users/anuj/pico/deps/zephyr/soc/xlnx/zynq7000/Kconfig"
osource "/Users/anuj/pico/deps/zephyr/soc/xlnx/versalnet/Kconfig"
osource "/Users/anuj/pico/deps/zephyr/soc/xlnx/versal2/Kconfig"
osource "/Users/anuj/pico/deps/zephyr/soc/xen/Kconfig"
osource "/Users/anuj/pico/deps/zephyr/soc/wch/ch32v/Kconfig"
osource "/Users/anuj/pico/deps/zephyr/soc/ti/simplelink/Kconfig"
osource "/Users/anuj/pico/deps/zephyr/soc/ti/mspm0/Kconfig"
osource "/Users/anuj/pico/deps/zephyr/soc/ti/lm3s6965/Kconfig"
osource "/Users/anuj/pico/deps/zephyr/soc/ti/k3/Kconfig"
osource "/Users/anuj/pico/deps/zephyr/soc/telink/tlsr/Kconfig"
osource "/Users/anuj/pico/deps/zephyr/soc/starfive/jh71xx/Kconfig"
osource "/Users/anuj/pico/deps/zephyr/soc/st/stm32/Kconfig"
osource "/Users/anuj/pico/deps/zephyr/soc/snps/qemu_arc/Kconfig"
osource "/Users/anuj/pico/deps/zephyr/soc/snps/nsim/arc_v/Kconfig"
osource "/Users/anuj/pico/deps/zephyr/soc/snps/nsim/arc_classic/Kconfig"
osource "/Users/anuj/pico/deps/zephyr/soc/snps/hsdk4xd/Kconfig"
osource "/Users/anuj/pico/deps/zephyr/soc/snps/hsdk/Kconfig"
osource "/Users/anuj/pico/deps/zephyr/soc/snps/emsk/Kconfig"
osource "/Users/anuj/pico/deps/zephyr/soc/snps/emsdp/Kconfig"
osource "/Users/anuj/pico/deps/zephyr/soc/snps/arc_iot/Kconfig"
osource "/Users/anuj/pico/deps/zephyr/soc/silabs/Kconfig"
osource "/Users/anuj/pico/deps/zephyr/soc/sifive/sifive_freedom/Kconfig"
osource "/Users/anuj/pico/deps/zephyr/soc/sensry/Kconfig"
osource "/Users/anuj/pico/deps/zephyr/soc/rockchip/Kconfig"
osource "/Users/anuj/pico/deps/zephyr/soc/renode/riscv_virtual/Kconfig"
osource "/Users/anuj/pico/deps/zephyr/soc/renode/cortex_r8_virtual/Kconfig"
osource "/Users/anuj/pico/deps/zephyr/soc/renesas/smartbond/Kconfig"
osource "/Users/anuj/pico/deps/zephyr/soc/renesas/rz/Kconfig"
osource "/Users/anuj/pico/deps/zephyr/soc/renesas/rx/Kconfig"
osource "/Users/anuj/pico/deps/zephyr/soc/renesas/rcar/Kconfig"
osource "/Users/anuj/pico/deps/zephyr/soc/renesas/ra/Kconfig"
osource "/Users/anuj/pico/deps/zephyr/soc/realtek/ec/Kconfig"
osource "/Users/anuj/pico/deps/zephyr/soc/raspberrypi/rpi_pico/Kconfig"
osource "/Users/anuj/pico/deps/zephyr/soc/quicklogic/eos_s3/Kconfig"
osource "/Users/anuj/pico/deps/zephyr/soc/qemu/virt_riscv/Kconfig"
osource "/Users/anuj/pico/deps/zephyr/soc/qemu/malta/Kconfig"
osource "/Users/anuj/pico/deps/zephyr/soc/openisa/rv32m1/Kconfig"
osource "/Users/anuj/pico/deps/zephyr/soc/openhwgroup/cva6/Kconfig"
osource "/Users/anuj/pico/deps/zephyr/soc/oct/osd32mp15x/Kconfig"
osource "/Users/anuj/pico/deps/zephyr/soc/nxp/s32/Kconfig"
osource "/Users/anuj/pico/deps/zephyr/soc/nxp/rw/Kconfig"
osource "/Users/anuj/pico/deps/zephyr/soc/nxp/mcx/Kconfig"
osource "/Users/anuj/pico/deps/zephyr/soc/nxp/lpc/Kconfig"
osource "/Users/anuj/pico/deps/zephyr/soc/nxp/layerscape/Kconfig"
osource "/Users/anuj/pico/deps/zephyr/soc/nxp/kinetis/Kconfig"
osource "/Users/anuj/pico/deps/zephyr/soc/nxp/imxrt/Kconfig"
osource "/Users/anuj/pico/deps/zephyr/soc/nxp/imx/Kconfig"
osource "/Users/anuj/pico/deps/zephyr/soc/nuvoton/numicro/Kconfig"
osource "/Users/anuj/pico/deps/zephyr/soc/nuvoton/numaker/Kconfig"
osource "/Users/anuj/pico/deps/zephyr/soc/nuvoton/npcx/Kconfig"
osource "/Users/anuj/pico/deps/zephyr/soc/nuvoton/npcm/Kconfig"
osource "/Users/anuj/pico/deps/zephyr/soc/nordic/Kconfig"
osource "/Users/anuj/pico/deps/zephyr/soc/neorv32/Kconfig"
osource "/Users/anuj/pico/deps/zephyr/soc/native/inf_clock/Kconfig"
osource "/Users/anuj/pico/deps/zephyr/soc/microchip/sam/Kconfig"
osource "/Users/anuj/pico/deps/zephyr/soc/microchip/miv/Kconfig"
osource "/Users/anuj/pico/deps/zephyr/soc/microchip/mec/Kconfig"
osource "/Users/anuj/pico/deps/zephyr/soc/mediatek/mt8xxx/Kconfig"
osource "/Users/anuj/pico/deps/zephyr/soc/lowrisc/opentitan/Kconfig"
osource "/Users/anuj/pico/deps/zephyr/soc/litex/litex_vexriscv/Kconfig"
osource "/Users/anuj/pico/deps/zephyr/soc/ite/ec/Kconfig"
osource "/Users/anuj/pico/deps/zephyr/soc/intel/raptor_lake/Kconfig"
osource "/Users/anuj/pico/deps/zephyr/soc/intel/lakemont/Kconfig"
osource "/Users/anuj/pico/deps/zephyr/soc/intel/intel_socfpga_std/Kconfig"
osource "/Users/anuj/pico/deps/zephyr/soc/intel/intel_socfpga/Kconfig"
osource "/Users/anuj/pico/deps/zephyr/soc/intel/intel_niosv/Kconfig"
osource "/Users/anuj/pico/deps/zephyr/soc/intel/intel_ish/Kconfig"
osource "/Users/anuj/pico/deps/zephyr/soc/intel/intel_adsp/Kconfig"
osource "/Users/anuj/pico/deps/zephyr/soc/intel/elkhart_lake/Kconfig"
osource "/Users/anuj/pico/deps/zephyr/soc/intel/atom/Kconfig"
osource "/Users/anuj/pico/deps/zephyr/soc/intel/apollo_lake/Kconfig"
osource "/Users/anuj/pico/deps/zephyr/soc/intel/alder_lake/Kconfig"
osource "/Users/anuj/pico/deps/zephyr/soc/infineon/cat3/Kconfig"
osource "/Users/anuj/pico/deps/zephyr/soc/infineon/cat1c/Kconfig"
osource "/Users/anuj/pico/deps/zephyr/soc/infineon/cat1b/Kconfig"
osource "/Users/anuj/pico/deps/zephyr/soc/infineon/cat1a/Kconfig"
osource "/Users/anuj/pico/deps/zephyr/soc/gd/gd32/Kconfig"
osource "/Users/anuj/pico/deps/zephyr/soc/gaisler/leon3/Kconfig"
osource "/Users/anuj/pico/deps/zephyr/soc/gaisler/gr716a/Kconfig"
osource "/Users/anuj/pico/deps/zephyr/soc/espressif/Kconfig"
osource "/Users/anuj/pico/deps/zephyr/soc/ene/kb1200/Kconfig"
osource "/Users/anuj/pico/deps/zephyr/soc/ene/kb106x/Kconfig"
osource "/Users/anuj/pico/deps/zephyr/soc/efinix/sapphire/Kconfig"
osource "/Users/anuj/pico/deps/zephyr/soc/cdns/xtensa_sample_controller/Kconfig"
osource "/Users/anuj/pico/deps/zephyr/soc/cdns/sample_controller32/Kconfig"
osource "/Users/anuj/pico/deps/zephyr/soc/cdns/dc233c/Kconfig"
osource "/Users/anuj/pico/deps/zephyr/soc/brcm/bcmvk/Kconfig"
osource "/Users/anuj/pico/deps/zephyr/soc/brcm/bcm2712/Kconfig"
osource "/Users/anuj/pico/deps/zephyr/soc/brcm/bcm2711/Kconfig"
osource "/Users/anuj/pico/deps/zephyr/soc/bflb/Kconfig"
osource "/Users/anuj/pico/deps/zephyr/soc/atmel/sam0/Kconfig"
osource "/Users/anuj/pico/deps/zephyr/soc/atmel/sam/Kconfig"
osource "/Users/anuj/pico/deps/zephyr/soc/aspeed/Kconfig"
osource "/Users/anuj/pico/deps/zephyr/soc/arm/Kconfig"
osource "/Users/anuj/pico/deps/zephyr/soc/arm/beetle/Kconfig"
osource "/Users/anuj/pico/deps/zephyr/soc/antmicro/myra/Kconfig"
osource "/Users/anuj/pico/deps/zephyr/soc/andestech/Kconfig"
osource "/Users/anuj/pico/deps/zephyr/soc/amd/acp_6_0/Kconfig"
osource "/Users/anuj/pico/deps/zephyr/soc/ambiq/Kconfig"
osource "/Users/anuj/pico/deps/zephyr/soc/aesc/Kconfig"
osource "/Users/anuj/pico/deps/zephyr/soc/adi/max32/Kconfig"
```

## PID control/build/primary/Kconfig/soc/Kconfig.soc
```kconfig
# Load SoC Kconfig descriptions.
osource "/Users/anuj/pico/deps/zephyr/soc/xlnx/zynqmp/Kconfig.soc"
osource "/Users/anuj/pico/deps/zephyr/soc/xlnx/zynq7000/Kconfig.soc"
osource "/Users/anuj/pico/deps/zephyr/soc/xlnx/versalnet/Kconfig.soc"
osource "/Users/anuj/pico/deps/zephyr/soc/xlnx/versal2/Kconfig.soc"
osource "/Users/anuj/pico/deps/zephyr/soc/xen/Kconfig.soc"
osource "/Users/anuj/pico/deps/zephyr/soc/wch/ch32v/Kconfig.soc"
osource "/Users/anuj/pico/deps/zephyr/soc/ti/simplelink/Kconfig.soc"
osource "/Users/anuj/pico/deps/zephyr/soc/ti/mspm0/Kconfig.soc"
osource "/Users/anuj/pico/deps/zephyr/soc/ti/lm3s6965/Kconfig.soc"
osource "/Users/anuj/pico/deps/zephyr/soc/ti/k3/Kconfig.soc"
osource "/Users/anuj/pico/deps/zephyr/soc/telink/tlsr/Kconfig.soc"
osource "/Users/anuj/pico/deps/zephyr/soc/starfive/jh71xx/Kconfig.soc"
osource "/Users/anuj/pico/deps/zephyr/soc/st/stm32/Kconfig.soc"
osource "/Users/anuj/pico/deps/zephyr/soc/snps/qemu_arc/Kconfig.soc"
osource "/Users/anuj/pico/deps/zephyr/soc/snps/nsim/arc_v/Kconfig.soc"
osource "/Users/anuj/pico/deps/zephyr/soc/snps/nsim/arc_classic/Kconfig.soc"
osource "/Users/anuj/pico/deps/zephyr/soc/snps/hsdk4xd/Kconfig.soc"
osource "/Users/anuj/pico/deps/zephyr/soc/snps/hsdk/Kconfig.soc"
osource "/Users/anuj/pico/deps/zephyr/soc/snps/emsk/Kconfig.soc"
osource "/Users/anuj/pico/deps/zephyr/soc/snps/emsdp/Kconfig.soc"
osource "/Users/anuj/pico/deps/zephyr/soc/snps/arc_iot/Kconfig.soc"
osource "/Users/anuj/pico/deps/zephyr/soc/silabs/Kconfig.soc"
osource "/Users/anuj/pico/deps/zephyr/soc/sifive/sifive_freedom/Kconfig.soc"
osource "/Users/anuj/pico/deps/zephyr/soc/sensry/Kconfig.soc"
osource "/Users/anuj/pico/deps/zephyr/soc/rockchip/Kconfig.soc"
osource "/Users/anuj/pico/deps/zephyr/soc/renode/riscv_virtual/Kconfig.soc"
osource "/Users/anuj/pico/deps/zephyr/soc/renode/cortex_r8_virtual/Kconfig.soc"
osource "/Users/anuj/pico/deps/zephyr/soc/renesas/smartbond/Kconfig.soc"
osource "/Users/anuj/pico/deps/zephyr/soc/renesas/rz/Kconfig.soc"
osource "/Users/anuj/pico/deps/zephyr/soc/renesas/rx/Kconfig.soc"
osource "/Users/anuj/pico/deps/zephyr/soc/renesas/rcar/Kconfig.soc"
osource "/Users/anuj/pico/deps/zephyr/soc/renesas/ra/Kconfig.soc"
osource "/Users/anuj/pico/deps/zephyr/soc/realtek/ec/Kconfig.soc"
osource "/Users/anuj/pico/deps/zephyr/soc/raspberrypi/rpi_pico/Kconfig.soc"
osource "/Users/anuj/pico/deps/zephyr/soc/quicklogic/eos_s3/Kconfig.soc"
osource "/Users/anuj/pico/deps/zephyr/soc/qemu/virt_riscv/Kconfig.soc"
osource "/Users/anuj/pico/deps/zephyr/soc/qemu/malta/Kconfig.soc"
osource "/Users/anuj/pico/deps/zephyr/soc/openisa/rv32m1/Kconfig.soc"
osource "/Users/anuj/pico/deps/zephyr/soc/openhwgroup/cva6/Kconfig.soc"
osource "/Users/anuj/pico/deps/zephyr/soc/oct/osd32mp15x/Kconfig.soc"
osource "/Users/anuj/pico/deps/zephyr/soc/nxp/s32/Kconfig.soc"
osource "/Users/anuj/pico/deps/zephyr/soc/nxp/rw/Kconfig.soc"
osource "/Users/anuj/pico/deps/zephyr/soc/nxp/mcx/Kconfig.soc"
osource "/Users/anuj/pico/deps/zephyr/soc/nxp/lpc/Kconfig.soc"
osource "/Users/anuj/pico/deps/zephyr/soc/nxp/layerscape/Kconfig.soc"
osource "/Users/anuj/pico/deps/zephyr/soc/nxp/kinetis/Kconfig.soc"
osource "/Users/anuj/pico/deps/zephyr/soc/nxp/imxrt/Kconfig.soc"
osource "/Users/anuj/pico/deps/zephyr/soc/nxp/imx/Kconfig.soc"
osource "/Users/anuj/pico/deps/zephyr/soc/nuvoton/numicro/Kconfig.soc"
osource "/Users/anuj/pico/deps/zephyr/soc/nuvoton/numaker/Kconfig.soc"
osource "/Users/anuj/pico/deps/zephyr/soc/nuvoton/npcx/Kconfig.soc"
osource "/Users/anuj/pico/deps/zephyr/soc/nuvoton/npcm/Kconfig.soc"
osource "/Users/anuj/pico/deps/zephyr/soc/nordic/Kconfig.soc"
osource "/Users/anuj/pico/deps/zephyr/soc/neorv32/Kconfig.soc"
osource "/Users/anuj/pico/deps/zephyr/soc/native/inf_clock/Kconfig.soc"
osource "/Users/anuj/pico/deps/zephyr/soc/microchip/sam/Kconfig.soc"
osource "/Users/anuj/pico/deps/zephyr/soc/microchip/miv/Kconfig.soc"
osource "/Users/anuj/pico/deps/zephyr/soc/microchip/mec/Kconfig.soc"
osource "/Users/anuj/pico/deps/zephyr/soc/mediatek/mt8xxx/Kconfig.soc"
osource "/Users/anuj/pico/deps/zephyr/soc/lowrisc/opentitan/Kconfig.soc"
osource "/Users/anuj/pico/deps/zephyr/soc/litex/litex_vexriscv/Kconfig.soc"
osource "/Users/anuj/pico/deps/zephyr/soc/ite/ec/Kconfig.soc"
osource "/Users/anuj/pico/deps/zephyr/soc/intel/raptor_lake/Kconfig.soc"
osource "/Users/anuj/pico/deps/zephyr/soc/intel/lakemont/Kconfig.soc"
osource "/Users/anuj/pico/deps/zephyr/soc/intel/intel_socfpga_std/Kconfig.soc"
osource "/Users/anuj/pico/deps/zephyr/soc/intel/intel_socfpga/Kconfig.soc"
osource "/Users/anuj/pico/deps/zephyr/soc/intel/intel_niosv/Kconfig.soc"
osource "/Users/anuj/pico/deps/zephyr/soc/intel/intel_ish/Kconfig.soc"
osource "/Users/anuj/pico/deps/zephyr/soc/intel/intel_adsp/Kconfig.soc"
osource "/Users/anuj/pico/deps/zephyr/soc/intel/elkhart_lake/Kconfig.soc"
osource "/Users/anuj/pico/deps/zephyr/soc/intel/atom/Kconfig.soc"
osource "/Users/anuj/pico/deps/zephyr/soc/intel/apollo_lake/Kconfig.soc"
osource "/Users/anuj/pico/deps/zephyr/soc/intel/alder_lake/Kconfig.soc"
osource "/Users/anuj/pico/deps/zephyr/soc/infineon/cat3/Kconfig.soc"
osource "/Users/anuj/pico/deps/zephyr/soc/infineon/cat1c/Kconfig.soc"
osource "/Users/anuj/pico/deps/zephyr/soc/infineon/cat1b/Kconfig.soc"
osource "/Users/anuj/pico/deps/zephyr/soc/infineon/cat1a/Kconfig.soc"
osource "/Users/anuj/pico/deps/zephyr/soc/gd/gd32/Kconfig.soc"
osource "/Users/anuj/pico/deps/zephyr/soc/gaisler/leon3/Kconfig.soc"
osource "/Users/anuj/pico/deps/zephyr/soc/gaisler/gr716a/Kconfig.soc"
osource "/Users/anuj/pico/deps/zephyr/soc/espressif/Kconfig.soc"
osource "/Users/anuj/pico/deps/zephyr/soc/ene/kb1200/Kconfig.soc"
osource "/Users/anuj/pico/deps/zephyr/soc/ene/kb106x/Kconfig.soc"
osource "/Users/anuj/pico/deps/zephyr/soc/efinix/sapphire/Kconfig.soc"
osource "/Users/anuj/pico/deps/zephyr/soc/cdns/xtensa_sample_controller/Kconfig.soc"
osource "/Users/anuj/pico/deps/zephyr/soc/cdns/sample_controller32/Kconfig.soc"
osource "/Users/anuj/pico/deps/zephyr/soc/cdns/dc233c/Kconfig.soc"
osource "/Users/anuj/pico/deps/zephyr/soc/brcm/bcmvk/Kconfig.soc"
osource "/Users/anuj/pico/deps/zephyr/soc/brcm/bcm2712/Kconfig.soc"
osource "/Users/anuj/pico/deps/zephyr/soc/brcm/bcm2711/Kconfig.soc"
osource "/Users/anuj/pico/deps/zephyr/soc/bflb/Kconfig.soc"
osource "/Users/anuj/pico/deps/zephyr/soc/atmel/sam0/Kconfig.soc"
osource "/Users/anuj/pico/deps/zephyr/soc/atmel/sam/Kconfig.soc"
osource "/Users/anuj/pico/deps/zephyr/soc/aspeed/Kconfig.soc"
osource "/Users/anuj/pico/deps/zephyr/soc/arm/Kconfig.soc"
osource "/Users/anuj/pico/deps/zephyr/soc/arm/beetle/Kconfig.soc"
osource "/Users/anuj/pico/deps/zephyr/soc/antmicro/myra/Kconfig.soc"
osource "/Users/anuj/pico/deps/zephyr/soc/andestech/Kconfig.soc"
osource "/Users/anuj/pico/deps/zephyr/soc/amd/acp_6_0/Kconfig.soc"
osource "/Users/anuj/pico/deps/zephyr/soc/ambiq/Kconfig.soc"
osource "/Users/anuj/pico/deps/zephyr/soc/aesc/Kconfig.soc"
osource "/Users/anuj/pico/deps/zephyr/soc/adi/max32/Kconfig.soc"
```
